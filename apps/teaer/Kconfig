## apps/teaer/Kconfig
```kconfig
#
# For a description of the syntax of this configuration file,
# see the file kconfig-language.txt in the NuttX tools repository.
#

config APPS_TEAER
	tristate "Teaer"
	default n

if APPS_TEAER

config APPS_TEAER_PROGNAME
	string "Program name"
	default "teaer"
	---help---
		This is the name of the program that will be used when the NSH ELF
		program is installed.

config APPS_TEAER_PRIORITY
	int "Hello task priority"
	default 100

config APPS_TEAER_STACKSIZE
	int "Hello stack size"
	default DEFAULT_TASK_STACKSIZE

endif
```
